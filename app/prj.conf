## CMakeLists.txt
```
cmake_minimum_required(VERSION 3.20.0)

find_package(Zephyr REQUIRED HINTS $ENV{ZEPHYR_BASE})
project(ble_actor_endpoint)

list(APPEND CMAKE_MODULE_PATH ${ZEPHYR_BASE}/modules/nanopb)
include(nanopb)

target_sources(app PRIVATE
  src/main.c
  src/app_events.c
  src/echo_actor.c
  src/ping_actor.c
  src/measurement_actor.c
  src/log_actor.c
  src/storage/storage.c
)

target_include_directories(app PRIVATE
  src/include
  src/storage
)

add_subdirectory(src/ble)
add_subdirectory(src/hmi)

zephyr_nanopb_sources(app
  assets/proto/ble_transport.proto
  assets/proto/app_protocol.proto
)
```

## Kconfig
```
menu "Application configuration"

config APP_MCUMGR_CUSTOM_GROUP
	bool
	default y
	select MCUMGR_SMP_CBOR_MIN_DECODING_LEVEL_1
	select MCUMGR_SMP_CBOR_MIN_ENCODING_LEVEL_1
	help
	  The application mcumgr group decodes and encodes one CBOR map level.

endmenu

source "Kconfig.zephyr"
```

## prj.conf
```kconfig
CONFIG_ACTOR=y
CONFIG_ACTOR_SEND_AFTER=y
CONFIG_ACTOR_ASK=n
CONFIG_ACTOR_DIAGNOSTICS=n

CONFIG_DISPLAY=y

CONFIG_BT=y
CONFIG_BT_PERIPHERAL=y
CONFIG_BT_EXT_ADV=y
CONFIG_BT_SMP=y
CONFIG_BT_SETTINGS=y
CONFIG_BT_KEYS_OVERWRITE_OLDEST=y
CONFIG_SETTINGS=y
CONFIG_SETTINGS_NVS=y
CONFIG_FLASH=y
CONFIG_FLASH_MAP=y
CONFIG_NVS=y
CONFIG_FILE_SYSTEM=y
CONFIG_FILE_SYSTEM_LITTLEFS=y
CONFIG_FILE_SYSTEM_MKFS=y
CONFIG_BT_DEVICE_NAME="klab BLE"
CONFIG_BT_DEVICE_APPEARANCE=833
CONFIG_BT_GATT_CLIENT=y
CONFIG_BT_GATT_AUTO_UPDATE_MTU=y
CONFIG_BT_L2CAP_TX_MTU=247
CONFIG_BT_BUF_ACL_RX_SIZE=251
CONFIG_BT_BUF_ACL_TX_SIZE=251
CONFIG_BT_CTLR_DATA_LENGTH_MAX=251

CONFIG_NANOPB=y
CONFIG_CRC=y
```

## boards/bbc_microbit_v2.overlay
```dts
&flash0 {
	partitions {
		/delete-node/ storage_partition;

		/* Bluetooth bond settings. */
		storage_partition: partition@7a000 {
			label = "storage";
			reg = <0x0007a000 0x00002000>;
		};

		littlefs_partition: partition@7c000 {
			label = "littlefs";
			reg = <0x0007c000 0x00004000>;
		};
	};
};
```

## src/main.c
```c
#include <stdlib.h>

#include <ipc.h>
#include <zephyr/kernel.h>
#include <zephyr/sys/printk.h>
#include <zephyr/sys/sys_io.h>

#include "storage.h"

int main(void)
{
	printk("Example actor app\n");

	int rc = storage_init();
	if (rc != 0) {
		printk("storage initialization failed: %d\n", rc);
		return rc;
	}

	rc = ipc_start_all_actors();
	if (rc != 0) {
		printk("actors start failed: %d\n", rc);
		return rc;
	}
	printk("actors started and ready to go\n");

	return 0;
}
```

## src/app_events.c
```c
#include "app_events.h"

IPC_EVENT_DEFINE(AppRequestEvent);
IPC_EVENT_DEFINE(AppResponseEvent);
IPC_EVENT_DEFINE(LogAppendEvent);
```

## src/echo_actor.c
```c
#include "app_events.h"

IPC_ACTOR_DEFINE(echo_actor, "echo", 512, K_PRIO_PREEMPT(7), 2,
                 IPC_MESSAGE_MAX(AppMgmtRequestEvent));

IPC_ACTOR_HANDLE(echo_actor, AppMgmtRequestEvent, on_app_mgmt_request)
{
    ARG_UNUSED(self);
    ARG_UNUSED(raw_msg);

    if (msg->command != APP_MGMT_CMD_ECHO) {
        return;
    }

    app_mgmt_respond(msg->transaction, 0, 0U, msg->data, msg->data_len);
}
```

## src/file_actor.c
```c
#include <zephyr/kernel.h>
#include <zephyr/sys/printk.h>

#include "app_events.h"

#define DEMO_FILE_SIZE 2048U
#define DEMO_FILE_BLOCK_SIZE 256U

IPC_ACTOR_DEFINE(file_actor, "file", 768, K_PRIO_PREEMPT(7), 2,
                 IPC_MESSAGE_MAX(AppRequestEvent));

IPC_ACTOR_HANDLE(file_actor, AppRequestEvent, on_app_request_event)
{
    ARG_UNUSED(self);
    ARG_UNUSED(raw_msg);

    const RequestEnvelope *request = &msg->envelope;
    if (request->which_payload != RequestEnvelope_file_read_tag) {
        return;
    }

    const FileReadRequest *file_request = &request->payload.file_read;
    if (file_request->offset >= DEMO_FILE_SIZE) {
        printk("file actor: invalid offset=%u\n", file_request->offset);
        return;
    }

    uint32_t remaining = DEMO_FILE_SIZE - file_request->offset;
    uint32_t requested = file_request->max_bytes;
    uint16_t len = MIN((uint32_t) DEMO_FILE_BLOCK_SIZE,
                       MIN(requested == 0U ? DEMO_FILE_BLOCK_SIZE : requested, remaining));

    AppResponseEvent_payload_t response = {};
    FileDataResponse *file_data = &response.envelope.payload.file_data;

    response.envelope.request_id = request->request_id;
    response.envelope.source = request->source;
    response.envelope.which_payload = ResponseEnvelope_file_data_tag;
    file_data->transfer_id = file_request->transfer_id;
    file_data->offset = file_request->offset;
    file_data->data.size = len;
    file_data->final = (file_request->offset + len) == DEMO_FILE_SIZE;

    for (uint16_t i = 0U; i < len; ++i) {
        file_data->data.bytes[i] = (uint8_t) (file_request->offset + i);
    }

    int rc = ipc_publish(AppResponseEvent, response);
    if (rc != 0) {
        printk("file actor: failed to publish response: %d\n", rc);
    }
}
```

## src/log_actor.c
```c
#include <string.h>

#include <pb_encode.h>
#include <zephyr/kernel.h>
#include <zephyr/sys/printk.h>

#include "app_events.h"
#include "storage.h"

#define LOG_FILE_ID "logs"
#define LOG_PATH "/lfs/logs.bin"
#define FILE_BLOCK_SIZE 256U

static size_t encode_varint(uint8_t *encoded, size_t value)
{
    size_t len = 0;
    do {
        encoded[len] = value & 0x7fU;
        value >>= 7U;
        if (value != 0U) encoded[len] |= 0x80U;
        ++len;
    } while (value != 0U);
    return len;
}

static void publish_file(const RequestEnvelope *request)
{
    uint8_t data[FILE_BLOCK_SIZE];
    size_t read = 0;
    uint16_t wanted = MIN(request->payload.file_read.max_bytes ?
                          request->payload.file_read.max_bytes : FILE_BLOCK_SIZE, FILE_BLOCK_SIZE);
    if (storage_read(LOG_PATH, request->payload.file_read.offset, data, wanted, &read) != 0) return;

    AppResponseEvent_payload_t response = {};
    FileDataResponse *file = &response.envelope.payload.file_data;
    response.envelope.request_id = request->request_id;
    response.envelope.source = request->source;
    response.envelope.which_payload = ResponseEnvelope_file_data_tag;
    strcpy(file->file_id, LOG_FILE_ID);
    file->transfer_id = request->payload.file_read.transfer_id;
    file->offset = request->payload.file_read.offset;
    file->data.size = read;
    memcpy(file->data.bytes, data, read);
    file->final = read < wanted;
    (void)ipc_publish(AppResponseEvent, response);
}

IPC_ACTOR_DEFINE(log_actor, "log", 1024, K_PRIO_PREEMPT(7), 4,
                 IPC_MESSAGE_MAX(AppRequestEvent, LogAppendEvent));

IPC_ACTOR_HANDLE(log_actor, LogAppendEvent, on_log_append)
{
    ARG_UNUSED(self); ARG_UNUSED(raw_msg);
    uint8_t encoded[LogEntry_size];
    uint8_t record[LogEntry_size + (sizeof(size_t) * 8U + 6U) / 7U];
    pb_ostream_t stream = pb_ostream_from_buffer(encoded, sizeof(encoded));
    if (!pb_encode(&stream, LogEntry_fields, &msg->entry)) return;
    size_t length_size = encode_varint(record, stream.bytes_written);
    memcpy(record + length_size, encoded, stream.bytes_written);
    if (storage_append(LOG_PATH, record, length_size + stream.bytes_written) != 0) {
        printk("log actor: failed to append log entry\n");
    }
}

IPC_ACTOR_HANDLE(log_actor, AppRequestEvent, on_log_request)
{
    ARG_UNUSED(self); ARG_UNUSED(raw_msg);
    const RequestEnvelope *request = &msg->envelope;
    if (request->which_payload == RequestEnvelope_new_log_file_tag) {
        if (storage_reset(LOG_PATH) != 0) return;
        AppResponseEvent_payload_t response = {};
        response.envelope.request_id = request->request_id;
        response.envelope.source = request->source;
        response.envelope.which_payload = ResponseEnvelope_new_log_file_tag;
        strcpy(response.envelope.payload.new_log_file.file_id, LOG_FILE_ID);
        (void)ipc_publish(AppResponseEvent, response);
    } else if (request->which_payload == RequestEnvelope_file_read_tag &&
               strcmp(request->payload.file_read.file_id, LOG_FILE_ID) == 0) {
        publish_file(request);
    }
}
```

## src/mcumgr_app.c
```c
#include <errno.h>
#include <stdint.h>
#include <string.h>

#include <zephyr/mgmt/mcumgr/mgmt/mgmt.h>
#include <zephyr/mgmt/mcumgr/smp/smp.h>
#include <zephyr/net_buf.h>
#include <zephyr/sys/util.h>

#include "app_events.h"
#include "app_mcumgr_decode.h"
#include "app_mcumgr_encode.h"

/* User-defined mcumgr group: 64, commands: echo=0, ping=1, set-symbol=2. */
#define APP_MGMT_GROUP_ID 64U

static K_MUTEX_DEFINE(app_mgmt_request_lock);

static int dispatch_request(enum app_mgmt_command command, uint32_t value,
                            const uint8_t *data, uint16_t data_len,
                            struct app_mgmt_transaction *transaction)
{
    AppMgmtRequestEvent_payload_t request = {
        .command = command,
        .value = value,
        .data_len = data_len,
        .transaction = transaction,
    };
    int rc;

    if (data_len > sizeof(request.data)) {
        return -EMSGSIZE;
    }
    if (data != NULL) {
        memcpy(request.data, data, data_len);
    }

    k_sem_init(&transaction->completed, 0, 1);
    transaction->status = -EIO;
    transaction->data_len = 0U;

    /* A transaction lives on this handler's stack, so serialize SMP requests. */
    k_mutex_lock(&app_mgmt_request_lock, K_FOREVER);
    rc = ipc_publish(AppMgmtRequestEvent, request);
    if (rc == 0) {
        k_sem_take(&transaction->completed, K_FOREVER);
        rc = transaction->status;
    }
    k_mutex_unlock(&app_mgmt_request_lock);

    return rc;
}

static int encode_response(struct smp_streamer *ctxt,
                           int (*encode)(uint8_t *, size_t, const void *, size_t *),
                           const void *response)
{
    struct net_buf *buffer = ctxt->writer->nb;
    size_t encoded_len;
    int rc;

    rc = encode(buffer->data + buffer->len, net_buf_tailroom(buffer), response, &encoded_len);
    if (rc != ZCBOR_SUCCESS) {
        return MGMT_ERR_EMSGSIZE;
    }

    (void)net_buf_add(buffer, encoded_len);
    return MGMT_ERR_EOK;
}

static int encode_echo_response(struct smp_streamer *ctxt,
                                const struct echo_response *response)
{
    return encode_response(ctxt, (int (*)(uint8_t *, size_t, const void *, size_t *))
                                      cbor_encode_echo_response,
                           response);
}

static int encode_ping_response(struct smp_streamer *ctxt,
                                const struct ping_response *response)
{
    return encode_response(ctxt, (int (*)(uint8_t *, size_t, const void *, size_t *))
                                      cbor_encode_ping_response,
                           response);
}

static int encode_set_matrix_symbol_response(
    struct smp_streamer *ctxt, const struct set_matrix_symbol_response *response)
{
    return encode_response(ctxt, (int (*)(uint8_t *, size_t, const void *, size_t *))
                                      cbor_encode_set_matrix_symbol_response,
                           response);
}

static int app_mgmt_echo(struct smp_streamer *ctxt)
{
    struct echo_request request;
    struct echo_response response;
    struct app_mgmt_transaction transaction;
    int rc;

    rc = cbor_decode_echo_request(ctxt->reader->nb->data, ctxt->reader->nb->len, &request,
                                  NULL);
    if (rc != ZCBOR_SUCCESS) {
        return MGMT_ERR_EINVAL;
    }

    rc = dispatch_request(APP_MGMT_CMD_ECHO, 0U, request.app_data_m.value,
                          request.app_data_m.len, &transaction);
    if (rc != 0) {
        return MGMT_ERR_EUNKNOWN;
    }

    response.app_data_m.value = transaction.data;
    response.app_data_m.len = transaction.data_len;
    return encode_echo_response(ctxt, &response);
}

static int app_mgmt_ping(struct smp_streamer *ctxt)
{
    struct ping_request request;
    struct ping_response response;
    struct app_mgmt_transaction transaction;
    int rc;

    rc = cbor_decode_ping_request(ctxt->reader->nb->data, ctxt->reader->nb->len, &request,
                                  NULL);
    if (rc != ZCBOR_SUCCESS) {
        return MGMT_ERR_EINVAL;
    }

    rc = dispatch_request(APP_MGMT_CMD_PING, request.uint1uint, NULL, 0U, &transaction);
    if (rc != 0) {
        return MGMT_ERR_EUNKNOWN;
    }

    response.uint1uint = transaction.value;
    return encode_ping_response(ctxt, &response);
}

static int app_mgmt_set_matrix_symbol(struct smp_streamer *ctxt)
{
    struct set_matrix_symbol_request request;
    struct set_matrix_symbol_response response;
    struct app_mgmt_transaction transaction;
    int rc;

    rc = cbor_decode_set_matrix_symbol_request(ctxt->reader->nb->data,
                                               ctxt->reader->nb->len, &request, NULL);
    if (rc != ZCBOR_SUCCESS) {
        return MGMT_ERR_EINVAL;
    }

    rc = dispatch_request(APP_MGMT_CMD_SET_MATRIX_SYMBOL, request.matrix_symbol_m, NULL, 0U,
                          &transaction);
    if (rc != 0) {
        return MGMT_ERR_EINVAL;
    }

    response.matrix_symbol_m = transaction.value;
    return encode_set_matrix_symbol_response(ctxt, &response);
}

static const struct mgmt_handler app_mgmt_handlers[] = {
    { .mh_write = app_mgmt_echo },
    { .mh_write = app_mgmt_ping },
    { .mh_write = app_mgmt_set_matrix_symbol },
};

static struct mgmt_group app_mgmt_group = {
    .mg_handlers = app_mgmt_handlers,
    .mg_handlers_count = ARRAY_SIZE(app_mgmt_handlers),
    .mg_group_id = APP_MGMT_GROUP_ID,
    .custom_payload = true,
};

static int app_mgmt_register(void)
{
    mgmt_register_group(&app_mgmt_group);
    return 0;
}

SYS_INIT(app_mgmt_register, APPLICATION, CONFIG_APPLICATION_INIT_PRIORITY);
```

## src/measurement_actor.c
```c
#include <string.h>

#include <pb_encode.h>
#include <zephyr/kernel.h>
#include <zephyr/sys/crc.h>
#include <zephyr/sys/byteorder.h>
#include <zephyr/sys/printk.h>

#include "app_events.h"
#include "storage.h"

#define CURVE_FILE_ID "curve_1"
#define CURVE_PATH "/lfs/curve_1.bin"
/* BLE actor fragments this 512-byte response block into BLE notifications. */
#define FILE_BLOCK_SIZE 512U

BUILD_ASSERT(MeasurementCurve_size <= 1024U,
             "MeasurementCurve worst-case encoding must not exceed 1 KiB");

IPC_CMD_DEFINE_LOCAL(MeasurementTick, { uint32_t session_id; });

static bool acquisition_active;
static uint32_t active_session;
static uint32_t next_session;
static MeasurementCurve curve;
static uint8_t encoded_curve[MeasurementCurve_size];

static void schedule_tick(uint32_t session_id)
{
    MeasurementTick_payload_t tick = {.session_id = session_id};
    (void)ipc_send_after(MeasurementTick, 1000U, tick);
}

static size_t encode_varint(uint8_t *encoded, size_t value)
{
    size_t len = 0;
    do {
        encoded[len] = value & 0x7fU;
        value >>= 7U;
        if (value != 0U) encoded[len] |= 0x80U;
        ++len;
    } while (value != 0U);
    return len;
}

static bool append_measurement(const Measurement *measurement)
{
    uint8_t encoded[Measurement_size];
    uint8_t length[(sizeof(size_t) * 8U + 6U) / 7U];
    pb_ostream_t stream = pb_ostream_from_buffer(encoded, sizeof(encoded));
    if (!pb_encode(&stream, Measurement_fields, measurement)) return false;
    size_t length_size = encode_varint(length, stream.bytes_written);
    if (curve.measurement_records.size + length_size + stream.bytes_written >
        sizeof(curve.measurement_records.bytes)) return false;

    memcpy(&curve.measurement_records.bytes[curve.measurement_records.size], length, length_size);
    curve.measurement_records.size += length_size;
    memcpy(&curve.measurement_records.bytes[curve.measurement_records.size], encoded,
           stream.bytes_written);
    curve.measurement_records.size += stream.bytes_written;
    ++curve.count;
    return true;
}

/* The CRC covers the complete serialized MeasurementCurve; its trailer is excluded. */
static bool serialize_curve(uint32_t *crc, uint16_t *size)
{
    pb_ostream_t stream = pb_ostream_from_buffer(encoded_curve, sizeof(encoded_curve));
    if (!pb_encode(&stream, MeasurementCurve_fields, &curve)) return false;
    *size = stream.bytes_written;
    *crc = crc32_ieee(encoded_curve, *size);
    return true;
}

static void publish_curve(const RequestEnvelope *request)
{
    const GetMeasurementCurveRequest *request_curve = &request->payload.get_measurement_curve;
    uint8_t data[FILE_BLOCK_SIZE];
    size_t read = 0;
    uint16_t wanted = FILE_BLOCK_SIZE;
    printk("measurement actor: curve read offset=%u requested=%u\n", request_curve->offset,
           wanted);
    int rc = storage_read(CURVE_PATH, request_curve->offset, data, wanted, &read);
    if (rc != 0) {
        printk("measurement actor: curve read failed: %d\n", rc);
        return;
    }
    printk("measurement actor: curve read %u bytes\n", (unsigned int)read);

    AppResponseEvent_payload_t response = {};
    GetMeasurementCurveResponse *curve_response =
        &response.envelope.payload.get_measurement_curve;
    response.envelope.request_id = request->request_id;
    response.envelope.source = request->source;
    response.envelope.which_payload = ResponseEnvelope_get_measurement_curve_tag;
    curve_response->transfer_id = request_curve->transfer_id;
    curve_response->offset = request_curve->offset;
    curve_response->data.size = read;
    memcpy(curve_response->data.bytes, data, read);
    curve_response->final = read < wanted;
    rc = ipc_publish(AppResponseEvent, response);
    printk("measurement actor: curve response publish: %d\n", rc);
}

IPC_ACTOR_DEFINE(measurement_actor, "measurement", 3072, K_PRIO_PREEMPT(7), 4,
                 IPC_MESSAGE_MAX(AppRequestEvent, MeasurementTick));

IPC_ACTOR_HANDLE(measurement_actor, AppRequestEvent, on_measurement_request)
{
    ARG_UNUSED(self); ARG_UNUSED(raw_msg);
    const RequestEnvelope *request = &msg->envelope;
    printk("measurement actor: request id=%u payload=%d\n", request->request_id,
           request->which_payload);
    if (request->which_payload == RequestEnvelope_start_measurement_tag) {
        active_session = ++next_session;
        acquisition_active = false;
        curve = (MeasurementCurve){};
        curve.started_timestamp_ms = k_uptime_get();
        int rc = storage_reset(CURVE_PATH);
        if (rc != 0) {
            printk("measurement actor: curve reset failed: %d\n", rc);
            return;
        }
        acquisition_active = true;
        schedule_tick(active_session);

        AppResponseEvent_payload_t response = {};
        response.envelope.request_id = request->request_id;
        response.envelope.source = request->source;
        response.envelope.which_payload = ResponseEnvelope_start_measurement_tag;
        strcpy(response.envelope.payload.start_measurement.file_id, CURVE_FILE_ID);
        (void)ipc_publish(AppResponseEvent, response);
    } else if (request->which_payload == RequestEnvelope_stop_measurement_tag) {
        acquisition_active = false;
        uint32_t crc;
        uint16_t size;
        if (!serialize_curve(&crc, &size)) {
            printk("measurement actor: curve serialization failed\n");
            return;
        }
        printk("measurement actor: writing curve size=%u count=%u crc=0x%08x\n", size,
               curve.count, crc);
        uint8_t crc_trailer[sizeof(crc)];
        sys_put_le32(crc, crc_trailer);
        int rc = storage_write(CURVE_PATH, encoded_curve, size);
        if (rc == 0) rc = storage_append(CURVE_PATH, crc_trailer, sizeof(crc_trailer));
        if (rc != 0) {
            printk("measurement actor: curve write failed: %d\n", rc);
            return;
        }

        AppResponseEvent_payload_t response = {};
        response.envelope.request_id = request->request_id;
        response.envelope.source = request->source;
        response.envelope.which_payload = ResponseEnvelope_stop_measurement_tag;
        strcpy(response.envelope.payload.stop_measurement.file_id, CURVE_FILE_ID);
        (void)ipc_publish(AppResponseEvent, response);
    } else if (request->which_payload == RequestEnvelope_get_measurement_curve_tag) {
        publish_curve(request);
    }
}

IPC_ACTOR_HANDLE(measurement_actor, MeasurementTick, on_measurement_tick)
{
    ARG_UNUSED(self); ARG_UNUSED(raw_msg);
    if (!acquisition_active || msg->session_id != active_session) return;
    Measurement measurement = {
        .temperature = 2000U + curve.count,
        .humidity = 5000U + curve.count,
    };
    if (!append_measurement(&measurement)) {
        acquisition_active = false;
        printk("measurement actor: curve reached its 1 KiB capacity\n");
        return;
    }
    schedule_tick(active_session);
}
```

## src/ping_actor.c
```c
#include "app_events.h"

IPC_ACTOR_DEFINE(ping_actor, "ping", 512, K_PRIO_PREEMPT(7), 2,
                 IPC_MESSAGE_MAX(AppMgmtRequestEvent));

IPC_ACTOR_HANDLE(ping_actor, AppMgmtRequestEvent, on_app_mgmt_request)
{
    ARG_UNUSED(self);
    ARG_UNUSED(raw_msg);

    if (msg->command != APP_MGMT_CMD_PING) {
        return;
    }

    app_mgmt_respond(msg->transaction, 0, msg->value, NULL, 0U);
}
```

## src/smp_ble.c
```c
#include <zephyr/bluetooth/bluetooth.h>
#include <zephyr/bluetooth/conn.h>
#include <zephyr/bluetooth/gatt.h>
#include <zephyr/mgmt/mcumgr/transport/smp_bt.h>
#include <zephyr/sys/printk.h>

static const struct bt_data ad[] = {
    BT_DATA_BYTES(BT_DATA_FLAGS, BT_LE_AD_GENERAL | BT_LE_AD_NO_BREDR),
    BT_DATA_BYTES(BT_DATA_UUID128_ALL, SMP_BT_SVC_UUID_VAL),
};

static const struct bt_data sd[] = {
    BT_DATA(BT_DATA_NAME_COMPLETE, CONFIG_BT_DEVICE_NAME,
            sizeof(CONFIG_BT_DEVICE_NAME) - 1U),
};

static void advertise(void)
{
    int rc = bt_le_adv_start(BT_LE_ADV_CONN_FAST_1, ad, ARRAY_SIZE(ad), sd, ARRAY_SIZE(sd));

    if (rc != 0) {
        printk("smp: advertising failed: %d\n", rc);
        return;
    }

    printk("smp: advertising as %s\n", CONFIG_BT_DEVICE_NAME);
}

static void connected(struct bt_conn *conn, uint8_t err)
{
    ARG_UNUSED(conn);
    if (err != 0U) {
        printk("smp: connection failed: 0x%02x\n", err);
        advertise();
    }
}

static void disconnected(struct bt_conn *conn, uint8_t reason)
{
    ARG_UNUSED(conn);
    printk("smp: disconnected: 0x%02x\n", reason);
}

static void connection_recycled(void)
{
    /* The Bluetooth host has released connection resources; advertising is safe again. */
    advertise();
}

BT_CONN_CB_DEFINE(smp_conn_callbacks) = {
    .connected = connected,
    .disconnected = disconnected,
    .recycled = connection_recycled,
};

void smp_ble_start(void)
{
    int rc = bt_enable(NULL);

    if (rc != 0) {
        printk("smp: Bluetooth enable failed: %d\n", rc);
        return;
    }

    advertise();
}
```
